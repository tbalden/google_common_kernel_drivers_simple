## google-modules/soc/rdo/drivers/input/Kconfig
```kconfig
# SPDX-License-Identifier: GPL-2.0-only
#
# Input device configuration
#

config INPUT_POWER_KEYDEBUG
	tristate "Long Press Power Key Debugging"
	depends on INPUT
	help
	  Say Y here if you want to hook debug function to dump information
	  to debug device hang when power keys are long pressed.
```

## google-modules/wlan/wonder/Kconfig
```kconfig
# SPDX-License-Identifier: GPL-2.0-only
#
# Google Wonder WiFi Virtual Device Driver
#

config WONDER_SYAN_SUPPORT
	tristate "Wonder Vendor Support - SYAN"
	default n
	help
		Wonder Vendor Support - SYAN

config WONDER_TX_DEBUG
	tristate "Wonder TX Debug Message Support"
	default n
	help
		Wonder TX Debug Message Suppor

config WONDER_RX_DEBUG
	tristate "Wonder RX Debug Message Support"
	default n
	help
		Wonder RX Debug Message Suppor

config WONDER_RX_FILTER_SUPPORT
	tristate "Wonder RX Filter Support"
	default n
	help
		Wonder RX Filter Suppor
```
